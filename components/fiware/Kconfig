## components/fiware/Kconfig
```kconfig
menu "General FIWARE Configuration"
    depends on FIWARE_TASK_ENABLE

    config FIWARE_HOST
        string "FIWARE Service Host"
        default "192.168.152.90"
        help
            The host (IP) of the machine that hosts the FIWARE stack
endmenu

menu "FIWARE IoT Agent Configuration"
    depends on FIWARE_TASK_ENABLE
    
    config IOT_AGENT_SOUTH_PORT
        int "IoT Agent South Port"
        default 7896
        help
            The south port of the FIWARE IoT Agent
    
    config IOT_AGENT_RESOURCE
        string "IoT Agent Resource identifier"
        default "/iot/d"
        help 
            The resource identifier of the FIWARE IoT Agent
    
    config IOT_AGENT_APIKEY
        string "IoT Agent API key"
        default "openiot"
        help 
            The API key of the IoT Agent
    
    config IOT_AGENT_DEVICE_ID
        string "IoT Agent Device ID"
        default "edi001"
        help 
            The ID of this device in the IoT Agent
            
    config IOT_DEVICE_ENDPOINT
        string "IoT Device Endpoint"
        default "/api"
        help
            The endpoint on which the HTTP server listens to incoming commands
                    
    menu "COMMANDS"
        config IOT_AGENT_COMMAND_STRICT
            bool "Iot Agent strict command checking"
            help
                If the flag is set an incoming IoT Agent command will only be executed if the device ID matches

        config IOT_AGENT_COMMAND_NAME_LEN
            int "IoT Agent UltraLight command name length"
            default 32
            help
                The length of the buffer that stores the incoming command name

        config IOT_AGENT_COMMAND_PAYLOAD_LEN
            int "IoT Agent UltraLight command payload length"
            default 32
            help
                The length of the buffer that stores the incoming command payload
                        
        config IOT_AGENT_COMMAND_INIT_RESPONSE
            string "Initial response to IoT Command"
            default "RECEIVED"
            help
                The initial response of the http server endpoint to an incoming IoT Device command
    endmenu
endmenu

menu "FIWARE IdM Configuration"
    depends on FIWARE_TASK_ENABLE

    config FIWARE_IDM_PORT
        int "FIWARE IdM port"
        default 8088
        help
            The port of the FIWARE KeyRock IdM

    config FIWARE_IDM_APP_ID
        string "FIWARE IdM Application ID"
        default "47239baf-a484-4067-b22b-1cf0e7494e48"
        help
            The application (client) ID from KeyRock IdM

    config FIWARE_IDM_APP_SECRET
        string "FIWARE IdM Application secret"
        default "8c7d6e2d-5984-4595-99ee-a7872c730d17"
        help
            The application (client) secret from KeyRock IdM

    config FIWARE_IDM_USERNAME
        string "FIWARE IdM IoT Sensor username"
        default "iot_sensor_8ece83c7-3846-470a-90ed-52bc41c9661b"
        help
            The username of the IoT Sensor registered in KeyRock IdM

    config FIWARE_IDM_PASSWORD
        string "FIWARE IdM IoT Sensor password"
        default "iot_sensor_d859d9aa-733b-43b5-a67e-895b7c01affe"
        help
            The password of the IoT Sensor registered in KeyRock IdM
endmenu

menu "FIWARE Task Configuration"
    config FIWARE_TASK_ENABLE
        bool "Enable FIWARE task"
        help
            Enable or disable the communication task with the FIWARE IoT Platform

    config FIWARE_TASK_STACK_DEPTH
        int "FIWARE Task stack depth in WORDS"
        depends on FIWARE_TASK_ENABLE
        default 4000

    config FIWARE_TASK_PRIO
        int "Task priority"
        depends on FIWARE_TASK_ENABLE
        default 3
        help
            The priority of the task

    config FIWARE_TASK_MEASUREMENT_TIMEOUT
        int "Measurement timeout"
        depends on FIWARE_TASK_ENABLE
        default 1000
        help
            Specifies the wait time after which if no measurement is incoming, a command will be processed
endmenu
```

## components/mau/Kconfig
```kconfig
menu "MAU Task Configuration"
    config MAU_TASK_STACK_DEPTH
        int "MAU Stack depth in WORDS"
        default 4000

    config MAU_TASK_PRIO
        int "Task priority"
        default 15
        help
            "Priority of the task"

    config MAU_TX
        int "MAU Transfer pin"
        default 0
    
    config MAU_RX
        int "MAU Read pin"
        default 2

    config MAU_RTS
        int "MAU RTS pin"
        default 4

    config MAU_CTS
        int "MAU CTS pin"
        default 16

    config MAU_BAUD
        int "MAU communication baudrate"
        default 115200
endmenu
```

## components/ph/Kconfig
```kconfig
menu "pH Measurement"
    config PH_ENABLED
        bool "Enable pH measurements"

    config PH_ADC_CHANNEL
        int "ADC channel used"
        default 0
        range 0 8

    menu "pH Measurement Task"
        depends on PH_ENABLED
        config PH_TASK_STACK_DEPTH
            int "Task stack depth"
            default 4000

        config PH_TASK_PRIO
            int "Task priority"
            default 4
    endmenu
endmenu
```

## components/server/Kconfig
```kconfig
menu "HTTP Server"
    config HTTP_SERVER_PAYLOAD_LEN
        int "HTTP Server payload length"
        default 255
        help
            The maximum length of the incoming payload for the server
endmenu
```

## components/stepper/Kconfig
```kconfig
menu "Stepper Motor control"
    config STEPPER_MOTOR_ENABLED
        bool "Enable stepper motor control"

    config STEPPER_STEP_PIN
        depends on STEPPER_MOTOR_ENABLED
        int "Stepper step pin number"
        default 14

    config STEPPER_EN_PIN
        depends on STEPPER_MOTOR_ENABLED
        int "Stepper motor enable pin number"
        default 12

    config STEPPER_DIR_PIN
        depends on STEPPER_MOTOR_ENABLED
        int "Stepper motor direction pin number"
        default 13

    menu "Stepper Motor control task"
        depends on STEPPER_MOTOR_ENABLED

        config STEPPER_TASK_STACK_DEPTH
            int "Task stack depth in WORDS"
            default 4000

        config STEPPER_TASK_PRIO
            int "Task priority"
            default 4
    endmenu
endmenu
```

## components/task_intercom/Kconfig
```kconfig
menu "Inter Task Communication"
    config ITC_UART_QUEUE_SIZE
        int "ITC UART queue size"
        default 10
        help
            Queue size for the messages going to the Kawasaki Controller

    config ITC_UART_MESSAGE_SIZE
        int "ITC UART message size"
        default 255
        help 
            The size of a single message of the queue

    config ITC_MAU_QUEUE_SIZE
        int "ITC MAU queue size"
        default 10
        help
            Queue size for the messages going to the MAU

    config ITC_MAU_MESSAGE_SIZE
        int "ITC MAU message size"
        default 255
        help
            
            The size of a single message of the queue

    config ITC_IOTA_MEASUREMENT_QUEUE_SIZE
        int "ITC IoT Measurement queue size"
        default 10
        help
            Queue size for the IoT measurements

    config ITC_IOTA_MEASUREMENT_MESSAGE_SIZE
        int "ITC IoT Measurement message size"
        default 255
        help
            The size of a single message of the queue

    config ITC_IOTA_COMMAND_QUEUE_SIZE
        int "ITC IoT Command queue size"
        default 1
        help
            Queue size for incoming IoT Commands
endmenu
```

## components/uart/Kconfig
```kconfig
menu "UART Task Configuration"
    config UART_TASK_ENABLE
        bool "Enable task"
        help
            Enable or disable the UART task (communication with robot controller)

    config UART_TASK_PRIO
        int "Task priority"
        depends on UART_TASK_ENABLE
        default 20
        help
            Priority of the task

    config UART_RX
        int "Read pin number"
        depends on UART_TASK_ENABLE
        default 17

    config UART_TX
        int "Transmit pin number"
        depends on UART_TASK_ENABLE
        default 5
        
    config UART_RTS
        int "RTS pin"
        depends on UART_TASK_ENABLE
        default 18

    config UART_CTS
        int "CTS pin"
        depends on UART_TASK_ENABLE
        default 19
        
    config UART_BAUD
        int "Uart baudrate"
        depends on UART_TASK_ENABLE
        default 9600
        
endmenu
```

## components/vreg/Kconfig
```kconfig
menu "Voltage Regulator"
    config VREG_ENABLED
        bool "Voltage regulator enabled"
        default true

    config VREG_BAUD
        int "Voltage regulator UART Baudrate"
        default 9600

    config VREG_RX_PIN
        int "RX Pin"
        default 16

    config VREG_TX_PIN
        int "TX Pin"
        default 4

    config VREG_RX_BUFFER_SIZE
        int "RX buffer size"
        default 1024

    config VREG_TX_BUFFER_SIZE
        int "TX buffer size"
        default 1024

    config VREG_QUEUE_SIZE
        int "Queue size for the UART"
        default 5

    menu "Voltage Regulator Task"
        depends on VREG_ENABLED

        config VREG_TASK_PRIO
            int "Task priority"
            default 4

        config VREG_TASK_STACK_DEPTH
            int "Stack depth in WORDS"
            default 4000

    endmenu
endmenu
```

## components/wifi/Kconfig
```kconfig
menu "WiFi Connection"
    config WIFI_STATION_NAME
        string "Name of the station to connect to"
    
    config WIFI_STATION_PASSWORD
        string "Password of the station"

    menu "WiFi Task"
        config WIFI_TASK_STACK_DEPTH
            int "Depth of the stack allocated to the WiFi Task in WORDS"
            default 4000

        config WIFI_TASK_PRIORITY
            int "WiFi Task priority"
            default 5
    endmenu
endmenu
```

## main/Kconfig.projbuild
```kconfig
menu "GPIO"
    choice  INPUT_PULL_MODE
        prompt "Select input pin pull mode"

        config INPUT_PULL_MODE_PULLUP
            bool "Pullup"

        config INPUT_PULL_MODE_PULLDOWN
            bool "Pulldown"
    endchoice
endmenu
```
